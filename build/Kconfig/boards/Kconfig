## build/Kconfig/boards/Kconfig
```kconfig
# Load Zephyr board Kconfig descriptions.
osource "/workdir/zephyr/boards/nordic/nrf5340dk/Kconfig"
```

## build/Kconfig/boards/Kconfig.defconfig
```kconfig
# Load Zephyr board defconfig descriptions.
osource "/workdir/zephyr/boards/nordic/nrf5340dk/Kconfig.defconfig"
```

## build/Kconfig/boards/Kconfig.nrf5340dk
```kconfig
# Load board Kconfig descriptions.
osource "/workdir/zephyr/boards/nordic/nrf5340dk/Kconfig.nrf5340dk"
```

## modules/sensor/drivers/tsl2591/Kconfig
```kconfig
# Create a new option in menuconfig
config TSL2591
    bool "TSL2591 Light Sensor"
    default n
    depends on # I2C must be enabled to let the sensor function #FINISH
    help
        Enable TSL2591 Light Sensor
```

## modules/sensor/dts/bindings/sensor/adafruit,tsl2491.yaml
```yaml
description: 
  Adafruit TSL2591 High Dynamic Range Digital Light Sensor
    accessed through I2C bus.

# Compatible string that matches the one in the DT sopurce and DT_DRV_COMPAT macro
compatible: "adafruit,tsl2591"

include: i2c-device.yaml   # Inherits standard I2C properties like 'reg'
                          # Found in the dts/bindings/i2c folder in zephyr tree
# Define node properties from i2c or personal made
properties: 
# No need to list properties since we are just using "reg" which is defined
 # in the i2c .yaml file (INHERITED)
```
